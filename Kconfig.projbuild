## Kconfig.projbuild
```kconfig
menu "ESP-NN"

choice NN_OPTIMIZATIONS
   bool "Optimization for nn functions"
   default NN_OPTIMIZED
   help
      Use ANSI-C versions for verification and debug purpose.
      Optimisations are automatically picked up for a chipset.
      For ESP32-S3, assembly optimisations are selected.
      For ESP32-P4 and ESP32-S31, PIE (SIMD) optimisations are selected.
      For other platforms(viz., ESP32, ESP32-C3), generic optimisations are used.

config NN_ANSI_C
   bool "ANSI C"
   help
      ANSI C versions for verification and debug purposes.
config NN_OPTIMIZED
   bool "Optimized versions"
   help
      Optimisations are automatically picked up for a chipset.
      For ESP32-S3, assembly optimisations are selected.
      For ESP32-P4 and ESP32-S31, PIE (SIMD) optimisations are selected.
      For other platforms(viz., ESP32, ESP32-C3), generic optimisations are used.
endchoice

config NN_OPTIMIZATIONS
   int
   default 0 if NN_ANSI_C
   default 1 if NN_OPTIMIZED

config NN_SKIP_NUDGE
   bool "Use fast (non-bit-exact) requantization"
   depends on NN_OPTIMIZED
   default n
   help
      When enabled, kernels use a faster requantize path that may differ
      from the TFLite reference by +/-1 LSB at half-shift boundaries.
      On ESP32-S3, this also skips the nudge addition in the assembly
      requantize for ~20% speedup.
      Leave disabled for bit-exact behavior (recommended for tests and
      for matching reference outputs).

menu "Dual-core worker"
   depends on NN_OPTIMIZED && (IDF_TARGET_ESP32S3 || IDF_TARGET_ESP32P4) && !FREERTOS_UNICORE

config NN_DUAL_CORE_WORKER_STACK_SIZE
   int "Worker stack size (bytes)"
   range 2048 65536
   default 4096
   help
      Stack of the worker task that esp_nn_dual_core_enable() starts on the
      other core. It runs one kernel slice at a time; measured peak use is
      about 1.4 KB on ESP32-S3 and 0.9 KB on ESP32-P4, with timer interrupts
      and other PIE tasks on the same cores.

choice NN_DUAL_CORE_WORKER_STACK_PLACEMENT
   prompt "Worker stack memory"
   default NN_DUAL_CORE_WORKER_STACK_INTERNAL_FIRST
   help
      Where the worker's stack is allocated. The kernels store 128-bit
      vectors to it, so it always comes from memory that takes them.

config NN_DUAL_CORE_WORKER_STACK_INTERNAL_FIRST
   bool "Internal RAM, PSRAM as fallback"
   help
      Internal SIMD-capable RAM. When none is left, PSRAM, if the
      FreeRTOS option allowing task stacks in external memory is set.

config NN_DUAL_CORE_WORKER_STACK_PSRAM
   bool "PSRAM only"
   depends on SPIRAM && (FREERTOS_TASK_CREATE_ALLOW_EXT_MEM || SPIRAM_ALLOW_STACK_EXTERNAL_MEMORY)
   help
      Keeps the worker's stack out of internal RAM, for applications
      short of it. Stack accesses then go through the cache. The worker
      only runs esp-nn jobs, so it never runs while the flash cache is
      disabled. If no PSRAM is left, esp-nn stays single core.

endchoice

endmenu

endmenu
```

## bench_app/sdkconfig.defaults.esp32p4
```kconfig
# Enables high speed SPIRAM and other options
CONFIG_IDF_EXPERIMENTAL_FEATURES=y

#
# ESP System Settings
#
CONFIG_ESP_DEFAULT_CPU_FREQ_MHZ=360
CONFIG_ESP_DEFAULT_CPU_FREQ_MHZ_360=y

#
# ESP PSRAM
#
CONFIG_SPIRAM=y
CONFIG_SPIRAM_BOOT_INIT=y
CONFIG_SPIRAM_MODE_HEX=y
CONFIG_SPIRAM_SPEED_200M=y
CONFIG_SPIRAM_SPEED=200
CONFIG_SPIRAM_ALLOW_STACK_EXTERNAL_MEMORY=y
CONFIG_SPIRAM_ALLOW_BSS_SEG_EXTERNAL_MEMORY=n
CONFIG_SPIRAM_USE_CAPS_ALLOC=y
CONFIG_SPIRAM_TRY_ALLOCATE_WIFI_LWIP=y

# Force rev v3.x, if possible
CONFIG_ESP32P4_SELECTS_REV_LESS_V3=n
```

## test_app/sdkconfig.defaults.esp32s31
```kconfig
#
# ESP System Settings
#
CONFIG_ESP_DEFAULT_CPU_FREQ_MHZ=320
CONFIG_ESP_DEFAULT_CPU_FREQ_MHZ_320=y
```

## tests/Kconfig
```kconfig
menu "ESP-NN tests"
   depends on IDF_TARGET_ESP32P4

config NN_TEST_PIE_CONTEXT_SECONDS
   int "Two-task PIE context test duration (seconds)"
   range 0 3600
   default 10
   help
      How long esp_nn_pie_context_test() runs two PIE tasks on one core.
      0 skips the test.

config NN_TEST_PIE_CONTEXT_IRQ_US
   int "Extra timer interrupt period during the PIE context test (us)"
   range 0 100000
   default 10
   help
      Period of a GPTimer interrupt on the core under test, so interrupts
      also land inside the hardware loops. 0 turns it off; the task time
      slicing (tick interrupt) still preempts the tasks.
endmenu
```
