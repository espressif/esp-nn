## test_app/sdkconfig.defaults.esp32p4
```kconfig
# Enables high speed SPIRAM and other options
CONFIG_IDF_EXPERIMENTAL_FEATURES=y

#
# ESP System Settings
#
CONFIG_ESP_DEFAULT_CPU_FREQ_MHZ=360
CONFIG_ESP_DEFAULT_CPU_FREQ_MHZ_360=y

#
# ESP PSRAM
#
CONFIG_SPIRAM=y
CONFIG_SPIRAM_BOOT_INIT=y
CONFIG_SPIRAM_MODE_HEX=y
CONFIG_SPIRAM_SPEED_200M=y
CONFIG_SPIRAM_SPEED=200
CONFIG_SPIRAM_ALLOW_STACK_EXTERNAL_MEMORY=y
CONFIG_SPIRAM_ALLOW_BSS_SEG_EXTERNAL_MEMORY=n
CONFIG_SPIRAM_USE_CAPS_ALLOC=y
CONFIG_SPIRAM_TRY_ALLOCATE_WIFI_LWIP=y

#
# GDB Stub
#
CONFIG_ESP_GDBSTUB_ENABLED=y
CONFIG_ESP_SYSTEM_PANIC_GDBSTUB=y

#
# Heap memory debugging
#
# CONFIG_HEAP_POISONING_DISABLED is not set
CONFIG_HEAP_POISONING_LIGHT=y
```
